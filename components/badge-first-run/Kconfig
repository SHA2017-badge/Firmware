## components/badge-first-run/Kconfig
```kconfig
menu "SHA2017 Badge First Run"

config DEBUG_ADD_DELAYS
    bool "debug -- add delays"
    default n
    help
        Add delays to make all output readable.

config BASVS_BROKEN_BADGE
    bool "debug -- basvs broken badge"
    default n
    help
        One of my badges has a non-functioning SELECT button.
        Am using this config-option to avoid building final images
        with workarounds for it.

        You probably don't want this, unless you're using my badge.

config ALLOW_BATTERY_FIRST_BOOT
    bool "Allow battery present during first boot sequence"
    default n
    help
        If enabled the first run will not stop when battery voltage is detected, useful for developing

endmenu
```

## components/badge/Kconfig
```kconfig
menu "SHA2017 Badge"

choice SHA_BADGE_REV
    prompt "SHA Badge revision"
    default SHA_BADGE_V3
    help
        This option sets the SHA badge revision.

        - Rev1.0.0 Dev: Release candidate
          (may 2017)
        - Rev1.0.0 Dev without the MPR121 chip.
        - Rev0.1.0 Dev: Improved badge.
          (february 2017)
        - Rev0.0.1 Dev: The original development badge.
          (december 2016)
        - Plain ESP32 hardware

config SHA_BADGE_V3
    bool "Rev1.0.*"
config SHA_BADGE_V3_LITE
    bool "Rev1.0.* (without mpr121)"
config SHA_BADGE_V2
    bool "Rev0.1.0 Dev"
config SHA_BADGE_V1
    bool "Rev0.0.1 Dev"
config SHA_BADGE_NONE
    bool "Plain ESP32"
endchoice

choice SHA_BADGE_EINK_DEFAULT_TYPE
    prompt "SHA Badge e-ink default display type"
    default SHA_BADGE_EINK_DEF_DEPG0290B1
    depends on SHA_BADGE_V1 || SHA_BADGE_V2 || SHA_BADGE_V3 || SHA_BADGE_V3_LITE
    help
        The DEPG0290B1 is the cheaper alternative.
        The GDEH029A1 was the original e-ink display.

config SHA_BADGE_EINK_DEF_DEPG0290B1
    bool "DEPG0290B1"
config SHA_BADGE_EINK_DEF_GDEH029A1
    bool "GDEH029A1"
endchoice

config SHA_BADGE_LEDS_WS2812
    bool "Using WS2812 LEDS instead of SK6812"
    depends on SHA_BADGE_V2 || SHA_BADGE_V3 || SHA_BADGE_V3_LITE
    default n
    help
        On earlier developer boards, WS2812 leds were used
        instead of SK6812. This option modifies the data
        stream to emulate the SK6812 LEDS.

config SHA_BADGE_INPUT_DEBUG
    bool "Enable input debug messages"
    default n
    help
        Debugging

config SHA_BADGE_FXL6408_DEBUG
    bool "Enable FXL6408 port-expander debug messages"
    depends on SHA_BADGE_V2
    default n
    help
        Debugging

config SHA_BADGE_CPT112S_DEBUG
    bool "Enable CPT112S debug messages"
    depends on SHA_BADGE_V2
    default n
    help
        Debugging

config SHA_BADGE_MPR121_DEBUG
    bool "Enable MPR121 debug messages"
    depends on SHA_BADGE_V3
    default n
    help
        Debugging

config SHA_BADGE_MPR121_HARDCODE_BASELINE
    bool "Enable MPR121 hardcoded baseline values"
    depends on SHA_BADGE_V3
    default y
    help
        The baseline data was tested on one specific badge. Other badges
        might need different baselines. Disable this to use automatic
        base-line detection. (can cause buttons to not respond)

config SHA_BADGE_EINK_DEBUG
    bool "Enable eink debug messages"
    depends on SHA_BADGE_V1 || SHA_BADGE_V2 || SHA_BADGE_V3 || SHA_BADGE_V3_LITE
    default n
    help
        Debugging

config SHA_BADGE_EINK_LUT_DEBUG
    bool "Enable eink lookup-table debug messages"
    depends on SHA_BADGE_V1 || SHA_BADGE_V2 || SHA_BADGE_V3 || SHA_BADGE_V3_LITE
    default n
    help
        Debugging

config SHA_BADGE_POWER_DEBUG
    bool "Enable power/charging debug messages"
    depends on SHA_BADGE_V1 || SHA_BADGE_V2 || SHA_BADGE_V3 || SHA_BADGE_V3_LITE
    default n
    help
        Debugging

endmenu
```

## components/bpp-if/Kconfig
```kconfig
menu "SHA2017 BPP"

config SHA_BPP_ENABLE
    bool "Enable BPP"
    default y
    help
        Enable passive firmware and read-only filesystem updates

endmenu
```

## components/sha2017/Kconfig
```kconfig
menu "SHA2017 Badge OTA"

config OTA_SERVER_NAME
    string "OTA server name"
    default "badge.sha2017.org"
    help
        Hostname of the OTA server

config OTA_SERVER_PATH
    string "OTA server path"
    default "/firmware"
    help
        The path on the OTA server

endmenu
```

## components/ugfx-glue/Kconfig
```kconfig
menu "uGFX"

config SHA_BADGE_UGFX_GINPUT_DEBUG
    bool "Enable uGFX input debug messages"
    default n
    help
        Debugging

endmenu
```

## firmware/main/Kconfig.projbuild
```kconfig
menu "Connectivity"

config WIFI_USE
    bool "Use WiFi on badge"
    depends on WIFI_ENABLED
    default y
    help
        Let the badge use wifi

config WIFI_SSID
    string "WiFi SSID"
    depends on WIFI_USE
    default "SHA2017-badge"
    help
        SSID (network name) for the example to connect to.

config WIFI_PASSWORD
    string "WiFi Password"
    depends on WIFI_USE
    default "b4dg3r"
    help
        WiFi password (WPA or WPA2) for the example to use.

        Can be left blank if the network has no security set.

config DEBUG_ADD_DELAYS
    bool "debug -- add delays"
    default n
    help
        Add delays to make all output readable.

config BASVS_BROKEN_BADGE
    bool "debug -- basvs broken badge"
    default n
    help
        One of my badges has a non-functioning SELECT button.
        Am using this config-option to avoid building final images
        with workarounds for it.

        You probably don't want this, unless you're using my badge.

endmenu
```

## main/Kconfig.projbuild
```kconfig
menu "Connectivity"

config WIFI_USE
    bool "Use WiFi on badge"
    default y
    help
        Let the badge use wifi

config WIFI_SSID
    string "WiFi SSID"
    depends on WIFI_USE
    default "SHA2017-badge"
    help
        SSID (network name) for the example to connect to.

config WIFI_PASSWORD
    string "WiFi Password"
    depends on WIFI_USE
    default "b4dg3r"
    help
        WiFi password (WPA or WPA2) for the example to use.

        Can be left blank if the network has no security set.

endmenu
```
